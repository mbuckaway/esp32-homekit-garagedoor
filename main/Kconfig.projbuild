## main/Kconfig.projbuild
```kconfig
menu "Homekit Configuration"

    config HOMEKIT_USE_HARDCODED_SETUP_CODE
        bool "Use hard-coded setup code"
        default y
        help
            HomeKit does not recommend having the setup code programmed in the accessory as is.
            Instead, it expects setup info (salt-verifier pair) generated for the given setup code.
            Use this option only for testing purposes. For production, the setup info should be
            used.

    config HOMEKIT_SETUP_CODE
        string "HomeKit Setup Code"
        default "111-22-333"
        depends on HOMEKIT_USE_HARDCODED_SETUP_CODE
        help
            Setup code to be used for HomeKot pairing, if hard-coded setup code is enabled.

    config HOMEKIT_SETUP_ID
        string "HomeKit Setup Id"
        default "ES32"
        depends on HOMEKIT_USE_HARDCODED_SETUP_CODE
        help
            Setup id to be used for HomeKot pairing, if hard-coded setup code is enabled.

endmenu

menu "Garage Door GPIO Configuration"
    config GPIO_OUTPUT_IO_RELAY
        int "GPIO PIN for relay"
        default 26
        range 1 34
        help
            GPIO number (IOxx) to control the door opener relay
            GPIOs 35-39 are input-only so cannot be used as outputs.
        
    config GPIO_INPUT_IO_OPEN
        int "GPIO PIN for open sensor"
        default 27
        range 1 39
        help
            GPIO number (IOxx) to connect to the garage open sensor (garage door fully open)
            Input is active low (pulled to ground when switch closed)

    config GPIO_INPUT_IO_CLOSE
        int "GPIO PIN for close sensor"
        default 25
        range 1 39
        help
            GPIO number (IOxx) to connect to the garage close sensor (garage door fully closed)
            Input is active low (pulled to ground when switch closed)


endmenu
```

## sdkconfig.defaults
```kconfig
CONFIG_PARTITION_TABLE_CUSTOM=y
CONFIG_PARTITION_TABLE_CUSTOM_FILENAME="partitions_hap.csv"
CONFIG_PARTITION_TABLE_CUSTOM_APP_BIN_OFFSET=0x10000
CONFIG_FREERTOS_UNICORE=y
CONFIG_FREERTOS_ASSERT_ON_UNTESTED_FUNCTION=n
CONFIG_FREERTOS_ASSERT_FAIL_ABORT=n
CONFIG_FREERTOS_ASSERT_DISABLE=y
CONFIG_LWIP_MAX_SOCKETS=16
CONFIG_LWIP_SO_REUSE=y
CONFIG_LWIP_MAX_ACTIVE_TCP=12
CONFIG_LWIP_MAX_LISTENING_TCP=12
CONFIG_LWIP_UDP_RECVMBOX_SIZE=10
CONFIG_MBEDTLS_HARDWARE_MPI=y
CONFIG_MBEDTLS_HARDWARE_SHA=n
CONFIG_ESP_TASK_WDT=n
CONFIG_LWIP_AUTOIP=y
CONFIG_ESPTOOLPY_FLASHSIZE_4MB=y
CONFIG_LWIP_AUTOIP_RATE_LIMIT_INTERVAL=60
CONFIG_MP_BLOB_SUPPORT=y
CONFIG_ENABLE_UNIFIED_PROVISIONING=y
CONFIG_BT_BLUEDROID_ENABLED=y
CONFIG_BT_BLE_BLUFI_ENABLE=y

#
# BT config
#
CONFIG_BT_ENABLED=y
CONFIG_BTDM_CTRL_MODE_BLE_ONLY=y
CONFIG_BTDM_CTRL_MODE_BR_EDR_ONLY=n
CONFIG_BTDM_CTRL_MODE_BTDM=n
CONFIG_BTDM_CTRL_PINNED_TO_CORE_0=y
CONFIG_BTDM_CTRL_PINNED_TO_CORE_1=n
CONFIG_BTDM_CTRL_PINNED_TO_CORE=0
CONFIG_BTDM_CTRL_HCI_MODE_VHCI=y
CONFIG_BTDM_CTRL_HCI_MODE_UART_H4=n
CONFIG_BT_BLUEDROID_ENABLED=y
CONFIG_BT_BLUEDROID_PINNED_TO_CORE_0=y
CONFIG_BT_BLUEDROID_PINNED_TO_CORE_1=n
CONFIG_BT_BLUEDROID_PINNED_TO_CORE=0
CONFIG_BT_BTC_TASK_STACK_SIZE=3072
CONFIG_BT_BLUEDROID_MEM_DEBUG=n
CONFIG_BT_CLASSIC_ENABLED=n
CONFIG_BT_GATTS_ENABLE=y
CONFIG_BT_GATTC_ENABLE=n
CONFIG_BT_BLE_SMP_ENABLE=n
CONFIG_BL_ENABLE_SRVCHG_REG=y
CONFIG_BT_STACK_NO_LOG=n
CONFIG_BT_ACL_CONNECTIONS=4
CONFIG_BT_ALLOCATION_FROM_SPIRAM_FIRST=n
CONFIG_BT_BLE_DYNAMIC_ENV_MEMORY=n
CONFIG_BT_SMP_ENABLE=n
CONFIG_BT_BLE_BLUFI_ENABLE=y
CONFIG_MBEDTLS_HARDWARE_MPI=n
```
